## Kconfig
```kconfig
# GRLIB Master Kconfig - Flat inclusion of all components
mainmenu "GRLIB Master Configuration"

config AHBDW
    int "AHB Data Width"
    default 32

config AHB_ACDM
    int "Enable AMBA Compliant Data Muxing"
    default 0

config ACTIVE_DESIGN_PREFIX
    string "Active Design Prefix (e.g. DESIGNS_LEON3_MINIMAL)"
    default ""

rsource "third_party/grlib/kconfig/bin/tkconfig/config.in.Kconfig"
rsource "third_party/grlib/kconfig/designs/leon3-ahbfile/config.in.Kconfig"
rsource "third_party/grlib/kconfig/designs/leon3-ahbfile/config.vhd.in.Kconfig"
rsource "third_party/grlib/kconfig/designs/leon3-altera-c5ekit/config.in.Kconfig"
rsource "third_party/grlib/kconfig/designs/leon3-altera-c5ekit/config.vhd.in.Kconfig"
rsource "third_party/grlib/kconfig/designs/leon3-altera-de2-ep2c35/config.in.Kconfig"
rsource "third_party/grlib/kconfig/designs/leon3-altera-de2-ep2c35/config.vhd.in.Kconfig"
rsource "third_party/grlib/kconfig/designs/leon3-altera-ep2s60-ddr/config.in.Kconfig"
rsource "third_party/grlib/kconfig/designs/leon3-altera-ep2s60-ddr/config.vhd.in.Kconfig"
rsource "third_party/grlib/kconfig/designs/leon3-altera-ep2s60-sdr/config.in.Kconfig"
rsource "third_party/grlib/kconfig/designs/leon3-altera-ep2s60-sdr/config.vhd.in.Kconfig"
rsource "third_party/grlib/kconfig/designs/leon3-altera-ep3c25/config.in.Kconfig"
rsource "third_party/grlib/kconfig/designs/leon3-altera-ep3c25/config.vhd.in.Kconfig"
rsource "third_party/grlib/kconfig/designs/leon3-altera-ep3c25-eek/config.in.Kconfig"
rsource "third_party/grlib/kconfig/designs/leon3-altera-ep3c25-eek/config.vhd.in.Kconfig"
rsource "third_party/grlib/kconfig/designs/leon3-altera-ep3c25-eek/lcd.in.Kconfig"
rsource "third_party/grlib/kconfig/designs/leon3-altera-ep3sl150/config.in.Kconfig"
rsource "third_party/grlib/kconfig/designs/leon3-altera-ep3sl150/config.vhd.in.Kconfig"
rsource "third_party/grlib/kconfig/designs/leon3-arrow-bemicro-sdk/config.in.Kconfig"
rsource "third_party/grlib/kconfig/designs/leon3-arrow-bemicro-sdk/config.vhd.in.Kconfig"
rsource "third_party/grlib/kconfig/designs/leon3-asic/config.in.Kconfig"
rsource "third_party/grlib/kconfig/designs/leon3-asic/config.vhd.in.Kconfig"
rsource "third_party/grlib/kconfig/designs/leon3-avnet-3s1500/config.in.Kconfig"
rsource "third_party/grlib/kconfig/designs/leon3-avnet-3s1500/config.vhd.in.Kconfig"
rsource "third_party/grlib/kconfig/designs/leon3-avnet-eval-xc4vlx25/config.in.Kconfig"
rsource "third_party/grlib/kconfig/designs/leon3-avnet-eval-xc4vlx25/config.vhd.in.Kconfig"
rsource "third_party/grlib/kconfig/designs/leon3-avnet-eval-xc4vlx60/config.in.Kconfig"
rsource "third_party/grlib/kconfig/designs/leon3-avnet-eval-xc4vlx60/config.vhd.in.Kconfig"
rsource "third_party/grlib/kconfig/designs/leon3-clock-gate/config.in.Kconfig"
rsource "third_party/grlib/kconfig/designs/leon3-clock-gate/config.vhd.in.Kconfig"
rsource "third_party/grlib/kconfig/designs/leon3-digilent-anvyl/config.in.Kconfig"
rsource "third_party/grlib/kconfig/designs/leon3-digilent-anvyl/config.vhd.in.Kconfig"
rsource "third_party/grlib/kconfig/designs/leon3-digilent-arty-a7/config.in.Kconfig"
rsource "third_party/grlib/kconfig/designs/leon3-digilent-arty-a7/config.vhd.in.Kconfig"
rsource "third_party/grlib/kconfig/designs/leon3-digilent-atlys/config.in.Kconfig"
rsource "third_party/grlib/kconfig/designs/leon3-digilent-atlys/config.vhd.in.Kconfig"
rsource "third_party/grlib/kconfig/designs/leon3-digilent-basys3/config.in.Kconfig"
rsource "third_party/grlib/kconfig/designs/leon3-digilent-basys3/config.vhd.in.Kconfig"
rsource "third_party/grlib/kconfig/designs/leon3-digilent-nexys-video/config.in.Kconfig"
rsource "third_party/grlib/kconfig/designs/leon3-digilent-nexys-video/config.vhd.in.Kconfig"
rsource "third_party/grlib/kconfig/designs/leon3-digilent-nexys3/config.in.Kconfig"
rsource "third_party/grlib/kconfig/designs/leon3-digilent-nexys3/config.vhd.in.Kconfig"
rsource "third_party/grlib/kconfig/designs/leon3-digilent-nexys4/config.in.Kconfig"
rsource "third_party/grlib/kconfig/designs/leon3-digilent-nexys4/config.vhd.in.Kconfig"
rsource "third_party/grlib/kconfig/designs/leon3-digilent-nexys4ddr/config.in.Kconfig"
rsource "third_party/grlib/kconfig/designs/leon3-digilent-nexys4ddr/config.vhd.in.Kconfig"
rsource "third_party/grlib/kconfig/designs/leon3-digilent-xc3s1000/config.in.Kconfig"
rsource "third_party/grlib/kconfig/designs/leon3-digilent-xc3s1000/config.vhd.in.Kconfig"
rsource "third_party/grlib/kconfig/designs/leon3-digilent-xc3s1600e/config.in.Kconfig"
rsource "third_party/grlib/kconfig/designs/leon3-digilent-xc3s1600e/config.vhd.in.Kconfig"
rsource "third_party/grlib/kconfig/designs/leon3-digilent-xc7z020/config.in.Kconfig"
rsource "third_party/grlib/kconfig/designs/leon3-digilent-xc7z020/config.vhd.in.Kconfig"
rsource "third_party/grlib/kconfig/designs/leon3-digilent-xup/config.in.Kconfig"
rsource "third_party/grlib/kconfig/designs/leon3-digilent-xup/config.vhd.in.Kconfig"
rsource "third_party/grlib/kconfig/designs/leon3-gr-cpci-xc4v/config.in.Kconfig"
rsource "third_party/grlib/kconfig/designs/leon3-gr-cpci-xc4v/config.vhd.in.Kconfig"
rsource "third_party/grlib/kconfig/designs/leon3-gr-cpci-xc7k/config.in.Kconfig"
rsource "third_party/grlib/kconfig/designs/leon3-gr-cpci-xc7k/config.vhd.in.Kconfig"
rsource "third_party/grlib/kconfig/designs/leon3-gr-pci-xc5v/config.in.Kconfig"
rsource "third_party/grlib/kconfig/designs/leon3-gr-pci-xc5v/config.vhd.in.Kconfig"
rsource "third_party/grlib/kconfig/designs/leon3-gr-xc3s-1500/config.in.Kconfig"
rsource "third_party/grlib/kconfig/designs/leon3-gr-xc3s-1500/config.vhd.in.Kconfig"
rsource "third_party/grlib/kconfig/designs/leon3-gr-xc6s/config.in.Kconfig"
rsource "third_party/grlib/kconfig/designs/leon3-gr-xc6s/config.vhd.in.Kconfig"
rsource "third_party/grlib/kconfig/designs/leon3-gr-xcku/config.in.Kconfig"
rsource "third_party/grlib/kconfig/designs/leon3-gr-xcku/config.vhd.in.Kconfig"
rsource "third_party/grlib/kconfig/designs/leon3-gr740-mini-board/config.in.Kconfig"
rsource "third_party/grlib/kconfig/designs/leon3-gr740-mini-board/config.vhd.in.Kconfig"
rsource "third_party/grlib/kconfig/designs/leon3-lattice-lfcpnx-evn/config.in.Kconfig"
rsource "third_party/grlib/kconfig/designs/leon3-lattice-lfcpnx-evn/config.vhd.in.Kconfig"
rsource "third_party/grlib/kconfig/designs/leon3-lattice-lfcpnx-versa-evn/config.in.Kconfig"
rsource "third_party/grlib/kconfig/designs/leon3-lattice-lfcpnx-versa-evn/config.vhd.in.Kconfig"
rsource "third_party/grlib/kconfig/designs/leon3-lattice-lfd2nx-versa-evn/config.in.Kconfig"
rsource "third_party/grlib/kconfig/designs/leon3-lattice-lfd2nx-versa-evn/config.vhd.in.Kconfig"
rsource "third_party/grlib/kconfig/designs/leon3-lattice-lifcl-40-evn/config.in.Kconfig"
rsource "third_party/grlib/kconfig/designs/leon3-lattice-lifcl-40-evn/config.vhd.in.Kconfig"
rsource "third_party/grlib/kconfig/designs/leon3-nuhorizons-3s1500/config.in.Kconfig"
rsource "third_party/grlib/kconfig/designs/leon3-nuhorizons-3s1500/config.vhd.in.Kconfig"
rsource "third_party/grlib/kconfig/designs/leon3-terasic-de0-nano/config.in.Kconfig"
rsource "third_party/grlib/kconfig/designs/leon3-terasic-de0-nano/config.vhd.in.Kconfig"
rsource "third_party/grlib/kconfig/designs/leon3-terasic-de2-115/config.in.Kconfig"
rsource "third_party/grlib/kconfig/designs/leon3-terasic-de2-115/config.vhd.in.Kconfig"
rsource "third_party/grlib/kconfig/designs/leon3-terasic-de4/config.in.Kconfig"
rsource "third_party/grlib/kconfig/designs/leon3-terasic-de4/config.vhd.in.Kconfig"
rsource "third_party/grlib/kconfig/designs/leon3-terasic-s5gs-dsp/config.in.Kconfig"
rsource "third_party/grlib/kconfig/designs/leon3-terasic-s5gs-dsp/config.vhd.in.Kconfig"
rsource "third_party/grlib/kconfig/designs/leon3-xilinx-ac701/config.in.Kconfig"
rsource "third_party/grlib/kconfig/designs/leon3-xilinx-ac701/config.vhd.in.Kconfig"
rsource "third_party/grlib/kconfig/designs/leon3-xilinx-kc705/config.in.Kconfig"
rsource "third_party/grlib/kconfig/designs/leon3-xilinx-kc705/config.vhd.in.Kconfig"
rsource "third_party/grlib/kconfig/designs/leon3-xilinx-kcu105/config.in.Kconfig"
rsource "third_party/grlib/kconfig/designs/leon3-xilinx-kcu105/config.vhd.in.Kconfig"
rsource "third_party/grlib/kconfig/designs/leon3-xilinx-ml403/config.in.Kconfig"
rsource "third_party/grlib/kconfig/designs/leon3-xilinx-ml403/config.vhd.in.Kconfig"
rsource "third_party/grlib/kconfig/designs/leon3-xilinx-ml40x/config.in.Kconfig"
rsource "third_party/grlib/kconfig/designs/leon3-xilinx-ml40x/config.vhd.in.Kconfig"
rsource "third_party/grlib/kconfig/designs/leon3-xilinx-ml501/config.in.Kconfig"
rsource "third_party/grlib/kconfig/designs/leon3-xilinx-ml501/config.vhd.in.Kconfig"
rsource "third_party/grlib/kconfig/designs/leon3-xilinx-ml50x/config.in.Kconfig"
rsource "third_party/grlib/kconfig/designs/leon3-xilinx-ml50x/config.vhd.in.Kconfig"
rsource "third_party/grlib/kconfig/designs/leon3-xilinx-ml510/config.in.Kconfig"
rsource "third_party/grlib/kconfig/designs/leon3-xilinx-ml510/config.vhd.in.Kconfig"
rsource "third_party/grlib/kconfig/designs/leon3-xilinx-ml605/config.in.Kconfig"
rsource "third_party/grlib/kconfig/designs/leon3-xilinx-ml605/config.vhd.in.Kconfig"
rsource "third_party/grlib/kconfig/designs/leon3-xilinx-sp601/config.in.Kconfig"
rsource "third_party/grlib/kconfig/designs/leon3-xilinx-sp601/config.vhd.in.Kconfig"
rsource "third_party/grlib/kconfig/designs/leon3-xilinx-sp605/config.in.Kconfig"
rsource "third_party/grlib/kconfig/designs/leon3-xilinx-sp605/config.vhd.in.Kconfig"
rsource "third_party/grlib/kconfig/designs/leon3-xilinx-vc707/config.in.Kconfig"
rsource "third_party/grlib/kconfig/designs/leon3-xilinx-vc707/config.vhd.in.Kconfig"
rsource "third_party/grlib/kconfig/designs/leon3-xilinx-xc3sd-1800/config.in.Kconfig"
rsource "third_party/grlib/kconfig/designs/leon3-xilinx-xc3sd-1800/config.vhd.in.Kconfig"
rsource "third_party/grlib/kconfig/designs/leon3-xilinx-zc702/config.in.Kconfig"
rsource "third_party/grlib/kconfig/designs/leon3-xilinx-zc702/config.vhd.in.Kconfig"
rsource "third_party/grlib/kconfig/designs/leon3-ztex-ufm-111/config.in.Kconfig"
rsource "third_party/grlib/kconfig/designs/leon3-ztex-ufm-111/config.vhd.in.Kconfig"
rsource "third_party/grlib/kconfig/designs/leon3-ztex-ufm-115/config.in.Kconfig"
rsource "third_party/grlib/kconfig/designs/leon3-ztex-ufm-115/config.vhd.in.Kconfig"
rsource "third_party/grlib/kconfig/designs/leon3mp/config.in.Kconfig"
rsource "third_party/grlib/kconfig/designs/leon3mp/config.vhd.in.Kconfig"
rsource "third_party/grlib/kconfig/designs/leon5-altera-c5ekit/config.in.Kconfig"
rsource "third_party/grlib/kconfig/designs/leon5-altera-c5ekit/config.vhd.in.Kconfig"
rsource "third_party/grlib/kconfig/designs/leon5-lattice-lfcpnx-evn/config.in.Kconfig"
rsource "third_party/grlib/kconfig/designs/leon5-lattice-lfcpnx-evn/config.vhd.in.Kconfig"
rsource "third_party/grlib/kconfig/designs/leon5-lattice-lfcpnx-versa-evn/config.in.Kconfig"
rsource "third_party/grlib/kconfig/designs/leon5-lattice-lfcpnx-versa-evn/config.vhd.in.Kconfig"
rsource "third_party/grlib/kconfig/designs/leon5-xilinx-kc705/config.in.Kconfig"
rsource "third_party/grlib/kconfig/designs/leon5-xilinx-kc705/config.vhd.in.Kconfig"
rsource "third_party/grlib/kconfig/designs/leon5-xilinx-kcu105/config.in.Kconfig"
rsource "third_party/grlib/kconfig/designs/leon5-xilinx-kcu105/config.vhd.in.Kconfig"
rsource "third_party/grlib/kconfig/designs/leon5-xilinx-vc707/config.in.Kconfig"
rsource "third_party/grlib/kconfig/designs/leon5-xilinx-vc707/config.vhd.in.Kconfig"
rsource "third_party/grlib/kconfig/designs/leon5-xilinx-vcu128/config.in.Kconfig"
rsource "third_party/grlib/kconfig/designs/leon5-xilinx-vcu128/config.vhd.in.Kconfig"
rsource "third_party/grlib/kconfig/designs/noelv-digilent-arty-a7/config.in.Kconfig"
rsource "third_party/grlib/kconfig/designs/noelv-digilent-arty-a7/config.vhd.in.Kconfig"
rsource "third_party/grlib/kconfig/designs/noelv-generic/config.in.Kconfig"
rsource "third_party/grlib/kconfig/designs/noelv-generic/config.vhd.in.Kconfig"
rsource "third_party/grlib/kconfig/designs/noelv-lattice-lfcpnx-evn/config.in.Kconfig"
rsource "third_party/grlib/kconfig/designs/noelv-lattice-lfcpnx-evn/config.vhd.in.Kconfig"
rsource "third_party/grlib/kconfig/designs/noelv-lattice-lfcpnx-versa-evn/config.in.Kconfig"
rsource "third_party/grlib/kconfig/designs/noelv-lattice-lfcpnx-versa-evn/config.vhd.in.Kconfig"
rsource "third_party/grlib/kconfig/designs/noelv-xilinx-kcu105/config.in.Kconfig"
rsource "third_party/grlib/kconfig/designs/noelv-xilinx-kcu105/config.vhd.in.Kconfig"
rsource "third_party/grlib/kconfig/designs/noelv-xilinx-zcu102/config.in.Kconfig"
rsource "third_party/grlib/kconfig/designs/noelv-xilinx-zcu102/config.vhd.in.Kconfig"
rsource "third_party/grlib/kconfig/lib/esa/memoryctrl/mctrl.in.Kconfig"
rsource "third_party/grlib/kconfig/lib/esa/pci/pci_arb.in.Kconfig"
rsource "third_party/grlib/kconfig/lib/gaisler/can/can_mc.in.Kconfig"
rsource "third_party/grlib/kconfig/lib/gaisler/can/can_oc.in.Kconfig"
rsource "third_party/grlib/kconfig/lib/gaisler/can/grcan.in.Kconfig"
rsource "third_party/grlib/kconfig/lib/gaisler/canfd/grcanfd.in.Kconfig"
rsource "third_party/grlib/kconfig/lib/gaisler/ddr/ddr2sp.in.Kconfig"
rsource "third_party/grlib/kconfig/lib/gaisler/ddr/ddrsp.in.Kconfig"
rsource "third_party/grlib/kconfig/lib/gaisler/ddr/mig.in.Kconfig"
rsource "third_party/grlib/kconfig/lib/gaisler/ddr/mig_7series.in.Kconfig"
rsource "third_party/grlib/kconfig/lib/gaisler/gr1553b/gr1553b.in.Kconfig"
rsource "third_party/grlib/kconfig/lib/gaisler/gr1553b/gr1553b_2.in.Kconfig"
rsource "third_party/grlib/kconfig/lib/gaisler/grdmac2/grdmac2.in.Kconfig"
rsource "third_party/grlib/kconfig/lib/gaisler/greth/greth.in.Kconfig"
rsource "third_party/grlib/kconfig/lib/gaisler/greth/greth2.in.Kconfig"
rsource "third_party/grlib/kconfig/lib/gaisler/hssl/hssl.in.Kconfig"
rsource "third_party/grlib/kconfig/lib/gaisler/i2c/i2c.in.Kconfig"
rsource "third_party/grlib/kconfig/lib/gaisler/i2c/i2c2ahb.in.Kconfig"
rsource "third_party/grlib/kconfig/lib/gaisler/i2c/i2cslv.in.Kconfig"
rsource "third_party/grlib/kconfig/lib/gaisler/irqmp/irqmp.in.Kconfig"
rsource "third_party/grlib/kconfig/lib/gaisler/jtag/bscan.in.Kconfig"
rsource "third_party/grlib/kconfig/lib/gaisler/jtag/jtag.in.Kconfig"
rsource "third_party/grlib/kconfig/lib/gaisler/jtag/jtag2.in.Kconfig"
rsource "third_party/grlib/kconfig/lib/gaisler/l2cache/l2c.in.Kconfig"
rsource "third_party/grlib/kconfig/lib/gaisler/leon3/l3stat.in.Kconfig"
rsource "third_party/grlib/kconfig/lib/gaisler/leon3/leon3.in.Kconfig"
rsource "third_party/grlib/kconfig/lib/gaisler/leon4/l4stat.in.Kconfig"
rsource "third_party/grlib/kconfig/lib/gaisler/leon4/leon4.in.Kconfig"
rsource "third_party/grlib/kconfig/lib/gaisler/leon5/debug5.in.Kconfig"
rsource "third_party/grlib/kconfig/lib/gaisler/leon5/leon5.in.Kconfig"
rsource "third_party/grlib/kconfig/lib/gaisler/memctrl/ftmctrl.in.Kconfig"
rsource "third_party/grlib/kconfig/lib/gaisler/memctrl/ftsdctrl.in.Kconfig"
rsource "third_party/grlib/kconfig/lib/gaisler/memctrl/ftsrctrl.in.Kconfig"
rsource "third_party/grlib/kconfig/lib/gaisler/memctrl/sdctrl.in.Kconfig"
rsource "third_party/grlib/kconfig/lib/gaisler/memctrl/srctrl.in.Kconfig"
rsource "third_party/grlib/kconfig/lib/gaisler/memctrl/ssrctrl.in.Kconfig"
rsource "third_party/grlib/kconfig/lib/gaisler/misc/ahbram.in.Kconfig"
rsource "third_party/grlib/kconfig/lib/gaisler/misc/ahbrom.in.Kconfig"
rsource "third_party/grlib/kconfig/lib/gaisler/misc/ahbstat.in.Kconfig"
rsource "third_party/grlib/kconfig/lib/gaisler/misc/ftahbram.in.Kconfig"
rsource "third_party/grlib/kconfig/lib/gaisler/misc/gptimer.in.Kconfig"
rsource "third_party/grlib/kconfig/lib/gaisler/misc/gracectrl.in.Kconfig"
rsource "third_party/grlib/kconfig/lib/gaisler/misc/grgpio.in.Kconfig"
rsource "third_party/grlib/kconfig/lib/gaisler/misc/grgpio2.in.Kconfig"
rsource "third_party/grlib/kconfig/lib/gaisler/misc/grsysmon.in.Kconfig"
rsource "third_party/grlib/kconfig/lib/gaisler/misc/grversion.in.Kconfig"
rsource "third_party/grlib/kconfig/lib/gaisler/misc/ps2.in.Kconfig"
rsource "third_party/grlib/kconfig/lib/gaisler/misc/ps2vga.in.Kconfig"
rsource "third_party/grlib/kconfig/lib/gaisler/misc/svgactrl.in.Kconfig"
rsource "third_party/grlib/kconfig/lib/gaisler/nand/nandfctrl.in.Kconfig"
rsource "third_party/grlib/kconfig/lib/gaisler/nandfctrl2/nandfctrl2.in.Kconfig"
rsource "third_party/grlib/kconfig/lib/gaisler/net/edcl.in.Kconfig"
rsource "third_party/grlib/kconfig/lib/gaisler/noelv/noelv.in.Kconfig"
rsource "third_party/grlib/kconfig/lib/gaisler/pci/grpci1/pci.in.Kconfig"
rsource "third_party/grlib/kconfig/lib/gaisler/pci/grpci1/pci_mtf.in.Kconfig"
rsource "third_party/grlib/kconfig/lib/gaisler/pci/grpci1/pci_target.in.Kconfig"
rsource "third_party/grlib/kconfig/lib/gaisler/pci/grpci1/pcidma.in.Kconfig"
rsource "third_party/grlib/kconfig/lib/gaisler/pci/grpci2/grpci2.in.Kconfig"
rsource "third_party/grlib/kconfig/lib/gaisler/pci/pcitrace/pcitrace.in.Kconfig"
rsource "third_party/grlib/kconfig/lib/gaisler/pcie/pcie.in.Kconfig"
rsource "third_party/grlib/kconfig/lib/gaisler/spacewire/router.in.Kconfig"
rsource "third_party/grlib/kconfig/lib/gaisler/spacewire/spacewire.in.Kconfig"
rsource "third_party/grlib/kconfig/lib/gaisler/spi/spi2ahb.in.Kconfig"
rsource "third_party/grlib/kconfig/lib/gaisler/spi/spictrl.in.Kconfig"
rsource "third_party/grlib/kconfig/lib/gaisler/spi/spimctrl.in.Kconfig"
rsource "third_party/grlib/kconfig/lib/gaisler/subsys/leon_dsu_stat_base.in.Kconfig"
rsource "third_party/grlib/kconfig/lib/gaisler/uart/dcom.in.Kconfig"
rsource "third_party/grlib/kconfig/lib/gaisler/uart/uart1.in.Kconfig"
rsource "third_party/grlib/kconfig/lib/gaisler/uart/uart2.in.Kconfig"
rsource "third_party/grlib/kconfig/lib/gaisler/usb/grusb_dcl.in.Kconfig"
rsource "third_party/grlib/kconfig/lib/gaisler/usb/grusbdc.in.Kconfig"
rsource "third_party/grlib/kconfig/lib/gaisler/usb/grusbhc.in.Kconfig"
rsource "third_party/grlib/kconfig/lib/grlib/amba/amba.in.Kconfig"
rsource "third_party/grlib/kconfig/lib/grlib/util/debug.in.Kconfig"
rsource "third_party/grlib/kconfig/lib/techmap/clocks/clkgen.in.Kconfig"
rsource "third_party/grlib/kconfig/lib/techmap/gencomp/clkgen.in.Kconfig"
rsource "third_party/grlib/kconfig/lib/techmap/gencomp/tech.in.Kconfig"
rsource "third_party/grlib/kconfig/lib/testgrouppolito/pr/pr.in.Kconfig"
```
